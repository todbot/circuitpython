## ports/zephyr-cp/boards/nrf5340bsim_nrf5340_cpuapp.conf
```kconfig
# Configuration for nrf5340bsim simulated board
# Mirror settings from native_sim.conf for compatibility

CONFIG_GPIO=y

# Enable Bluetooth stack - bsim is for BT simulation
CONFIG_BT=y
CONFIG_BT_HCI=y
CONFIG_BT_OBSERVER=y
CONFIG_BT_BROADCASTER=y

CONFIG_BT_DEVICE_NAME_DYNAMIC=y
CONFIG_BT_DEVICE_NAME_MAX=28

# Ensure the network core image starts when using native simulator
CONFIG_NATIVE_SIMULATOR_AUTOSTART_MCU=y

CONFIG_TRACING=y
CONFIG_TRACING_PERFETTO=y
CONFIG_TRACING_SYNC=y
CONFIG_TRACING_BACKEND_POSIX=y
CONFIG_TRACING_GPIO=y
```

## ports/zephyr-cp/zephyr-config/west.yml
```yaml
manifest:
  group-filter:
    - +babblesim
  projects:
    - name: nrf_hw_models
      url: https://github.com/tannewt/ext_nRF_hw_models
      revision: c2927847bdf2ee0af9c5459f4155c67f39f6837a
      path: modules/bsim_hw_models/nrf_hw_models
    - name: zephyr
      url: https://github.com/adafruit/zephyr
      revision: e1dc85052bc8928572fdb972997c65eeb96f555b
      clone-depth: 100
      import: true
```
